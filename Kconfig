## Kconfig
```kconfig
config CCA_SCREENKEY
	bool "ScreenKey displays"
	default y
	depends on DT_HAS_CCA_SCREENKEYS_ENABLED
	select DISPLAY
	select PWM
	help
	  Drive the ScreenKey displays described by the "cca,screenkeys"
	  devicetree node. Each press of a ScreenKey's switch toggles its face.

if CCA_SCREENKEY

config CCA_SCREENKEY_BACKLIGHT_PERCENT
	int "Backlight brightness in percent"
	range 0 100
	default 100

config CCA_SCREENKEY_RESET_INIT_PRIORITY
	int "Shared display reset init priority"
	default 80
	help
	  POST_KERNEL priority of the shared reset pulse. It must be lower
	  (earlier) than DISPLAY_INIT_PRIORITY so the panels are reset before
	  the display drivers initialize them.

config CCA_SCREENKEY_THREAD_STACK_SIZE
	int "Drawing thread stack size"
	default 1024

config CCA_SCREENKEY_THREAD_PRIORITY
	int "Drawing thread priority"
	default 10

module = CCA_SCREENKEY
module-str = ScreenKey
source "subsys/logging/Kconfig.template.log_config"

endif # CCA_SCREENKEY
```

## dts/bindings/cca,screenkeys.yaml
```yaml
description: |
  Waveshare 0.85" ScreenKeys. Each ScreenKey is a display (a
  sitronix,st7735r node on a shared SPI bus, with its own chip select) and a
  switch wired into the ZMK key matrix. Each press of a ScreenKey's switch
  toggles the face shown on its display.

compatible: "cca,screenkeys"

properties:
  reset-gpios:
    type: phandle-array
    description: |
      Reset line shared by all ScreenKey displays (active low). It is pulsed
      once before the display drivers start, which then reset each panel in
      software. Do not also give it to the display nodes. Omit it when each
      display node has its own reset-gpios.

  pwms:
    type: phandle-array
    description: |
      Backlight PWM shared by all ScreenKeys. Omit it when the backlights are
      not controlled by the MCU.

child-binding:
  description: A single ScreenKey.
  properties:
    display:
      type: phandle
      required: true
      description: The ScreenKey's display.

    key-position:
      type: int
      required: true
      description: ZMK key position (matrix transform index) of the ScreenKey's switch.
```
